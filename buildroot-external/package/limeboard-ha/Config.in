## buildroot-external/package/limeboard-ha/Config.in
```kconfig
config BR2_PACKAGE_LIMEBOARD_HA
	bool "limeboard-ha"
	depends on BR2_PACKAGE_PYTHON3
	depends on BR2_PACKAGE_HAS_UDEV # limeboard-io
	depends on BR2_arm # python-gpiozero
	select BR2_PACKAGE_PYTHON3_SSL # paho-mqtt imports ssl
	select BR2_PACKAGE_PYTHON_PAHO_MQTT
	select BR2_PACKAGE_PYTHON_PSUTIL
	select BR2_PACKAGE_LIMEBOARD_IO
	select BR2_PACKAGE_LIMEBOARD_IO_GPIOZERO
	help
	  Makes the Limeboard a Home Assistant device through MQTT
	  discovery: the phone's system state (psutil) and sensors,
	  and the board's RGB LED and button (gpiozero on the
	  Limeboard I/O firmware). Configured in
	  /etc/limeboard-ha.conf.

comment "limeboard-ha needs python3 and udev"
	depends on BR2_arm
	depends on !BR2_PACKAGE_PYTHON3 || !BR2_PACKAGE_HAS_UDEV
```

## buildroot-external/package/limeboard-io-firmware/Config.in
```kconfig
config BR2_PACKAGE_LIMEBOARD_IO_FIRMWARE
	bool "limeboard-io-firmware"
	depends on BR2_PACKAGE_HOST_ARM_GNU_TOOLCHAIN_SUPPORTS
	help
	  The Limeboard I/O firmware for the Limeboard's STM32F401,
	  built from source with the Arm GNU toolchain. Installs
	  /usr/share/limeboard/limeboard-io.bin and its version, which
	  "limeboard-config firmware update" flashes over USB DFU.
```

## buildroot-external/package/limeboard-io/Config.in
```kconfig
config BR2_PACKAGE_LIMEBOARD_IO
	bool "limeboard-io"
	depends on BR2_PACKAGE_HAS_UDEV
	select BR2_PACKAGE_DFU_UTIL
	select BR2_PACKAGE_LIMEBOARD_IO_FIRMWARE if BR2_PACKAGE_HOST_ARM_GNU_TOOLCHAIN_SUPPORTS
	help
	  The Limeboard's STM32 with the Limeboard I/O firmware: its
	  Raspberry Pi style header as standard Linux devices through
	  the kernel's citronics-dln2 driver (GPIO chip
	  "citronics-dln2", I2C, SPI, ADC) and a USB serial port for the
	  header UART. Installs the udev rule naming that port
	  /dev/serial0, dfu-util to update the firmware, and /etc/limeboard/config.txt: the I2C
	  and SPI buses are off until it turns them on, with Raspberry
	  Pi config.txt lines (dtparam=i2c_arm=on, dtparam=spi=on...),
	  applied by limeboard-config (installed with python3).

	  Needs CONFIG_CITRONICS_DLN2 in the kernel.

if BR2_PACKAGE_LIMEBOARD_IO

config BR2_PACKAGE_LIMEBOARD_IO_GPIOZERO
	bool "gpiozero pin factory"
	depends on BR2_PACKAGE_PYTHON3
	depends on BR2_arm # python-gpiozero
	select BR2_PACKAGE_PYTHON_GPIOZERO
	select BR2_PACKAGE_PYTHON_LGPIO
	help
	  The "limeboard" pin factory for gpiozero: Raspberry Pi
	  gpiozero code runs on the header with
	  GPIOZERO_PIN_FACTORY=limeboard. It is gpiozero's lgpio
	  factory on the "citronics-dln2" GPIO chip.

config BR2_PACKAGE_LIMEBOARD_IO_PI_COMPAT
	bool "Raspberry Pi library compatibility"
	depends on BR2_PACKAGE_PYTHON3
	depends on BR2_arm # python-gpiozero
	select BR2_PACKAGE_LIMEBOARD_IO_GPIOZERO
	select BR2_PACKAGE_PYTHON_RPI_LGPIO
	select BR2_PACKAGE_PYTHON_SPIDEV
	help
	  Raspberry Pi GPIO code runs on the header without setup:
	  when the Limeboard I/O firmware is present, Python programs
	  start with gpiozero's "limeboard" pin factory selected,
	  RPi.GPIO (rpi-lgpio) on the Limeboard's GPIO chip, and the
	  Limeboard's board definition for Adafruit Blinka, when
	  Blinka is installed, and py-spidev for /dev/spidev.
	  LIMEBOARD_COMPAT=0 turns it off.

comment "gpiozero and Raspberry Pi compatibility need python3"
	depends on !BR2_PACKAGE_PYTHON3
	depends on BR2_arm

endif

comment "limeboard-io needs udev"
	depends on !BR2_PACKAGE_HAS_UDEV
```

## buildroot-external/package/modem-setup/Config.in
```kconfig
config BR2_PACKAGE_MODEM_SETUP
	bool "modem-setup"
	depends on BR2_PACKAGE_MODEM_MANAGER
	help
	  Modem setup for the Fairphone 2 and 3: before ModemManager,
	  prefer LTE and set the LTE attach APN from the NetworkManager
	  GSM connection; once registered on 2G or 3G, move to LTE once.
	  The same scripts as the citronics-lime-fp2/fp3 Debian packages.
```

## buildroot-external/package/python-lgpio/Config.in
```kconfig
config BR2_PACKAGE_PYTHON_LGPIO
	bool "python-lgpio"
	help
	  Python module of lg, the Linux GPIO library behind gpiozero's
	  default pin factory on the Raspberry Pi 5. It drives any
	  /dev/gpiochip device. Built with the lg C library linked in.

	  https://abyz.me.uk/lg/py_lgpio.html
```

## buildroot-external/package/python-rpi-lgpio/Config.in
```kconfig
config BR2_PACKAGE_PYTHON_RPI_LGPIO
	bool "python-rpi-lgpio"
	select BR2_PACKAGE_PYTHON_LGPIO # runtime
	help
	  The RPi.GPIO API on top of lgpio: Raspberry Pi code that
	  imports RPi.GPIO runs on any Linux GPIO chip, selected with
	  RPI_LGPIO_CHIP.

	  https://rpi-lgpio.readthedocs.io/
```

## buildroot-external/package/qbootctl/Config.in
```kconfig
config BR2_PACKAGE_QBOOTCTL
	bool "qbootctl"
	depends on BR2_TOOLCHAIN_HEADERS_AT_LEAST_4_9 # linux/bsg.h
	help
	  Qualcomm A/B slot control (linux-msm/qbootctl). On the
	  Fairphone 3, marks the boot successful at the end of boot:
	  otherwise the stock bootloader falls back to the other slot
	  after a few boots, as Android would after a failed update.

	  https://github.com/linux-msm/qbootctl
```
