## buildroot-external/Config.in
```kconfig
source "$BR2_EXTERNAL_CITRONICS_PATH/package/fp2-adsp-sensors-demo/Config.in"
source "$BR2_EXTERNAL_CITRONICS_PATH/package/fp2-firmware/Config.in"
source "$BR2_EXTERNAL_CITRONICS_PATH/package/fp3-firmware/Config.in"
source "$BR2_EXTERNAL_CITRONICS_PATH/package/qrtr/Config.in"
source "$BR2_EXTERNAL_CITRONICS_PATH/package/rmtfs/Config.in"
source "$BR2_EXTERNAL_CITRONICS_PATH/package/sim-selector/Config.in"
source "$BR2_EXTERNAL_CITRONICS_PATH/package/citronics-initramfs/Config.in"
source "$BR2_EXTERNAL_CITRONICS_PATH/package/rpmsgexport/Config.in"
source "$BR2_EXTERNAL_CITRONICS_PATH/package/first-boot-resize/Config.in"
source "$BR2_EXTERNAL_CITRONICS_PATH/package/gps-assist/Config.in"
source "$BR2_EXTERNAL_CITRONICS_PATH/package/unudhcpd/Config.in"
source "$BR2_EXTERNAL_CITRONICS_PATH/package/kernel-tests/Config.in"
source "$BR2_EXTERNAL_CITRONICS_PATH/package/msm8974-diag/Config.in"
source "$BR2_EXTERNAL_CITRONICS_PATH/package/tqftpserv/Config.in"
source "$BR2_EXTERNAL_CITRONICS_PATH/package/hexagonrpc/Config.in"
source "$BR2_EXTERNAL_CITRONICS_PATH/package/reboot-mode/Config.in"
source "$BR2_EXTERNAL_CITRONICS_PATH/package/adsp-boot/Config.in"
source "$BR2_EXTERNAL_CITRONICS_PATH/package/acdb-loader/Config.in"
source "$BR2_EXTERNAL_CITRONICS_PATH/package/modem-boot/Config.in"
```

## buildroot-external/configs/lemon_rauc_defconfig
```kconfig
# Architecture
BR2_arm=y
BR2_cortex_a15=y
BR2_ARM_FPU_NEON_VFPV4=y
BR2_PACKAGE_HOST_LINUX_HEADERS_CUSTOM_6_12=y

# Mirrors
BR2_GNU_MIRROR="https://mirror.ibcp.fr/pub/gnu/"

# System configuration
BR2_ROOTFS_DEVICE_CREATION_DYNAMIC_EUDEV=y
BR2_TARGET_GENERIC_ROOT_PASSWD="root"
BR2_TARGET_GENERIC_GETTY_PORT="tty1"
BR2_ROOTFS_OVERLAY="$(BR2_EXTERNAL_CITRONICS_PATH)/board/lemon_rauc/overlay"
BR2_ROOTFS_POST_BUILD_SCRIPT="$(BR2_EXTERNAL_CITRONICS_PATH)/board/lemon_rauc/scripts/post-build.sh"
BR2_ROOTFS_POST_IMAGE_SCRIPT="$(BR2_EXTERNAL_CITRONICS_PATH)/board/lemon_rauc/scripts/post-image.sh"

# Linux kernel
BR2_LINUX_KERNEL=y
BR2_LINUX_KERNEL_CUSTOM_GIT=y
BR2_LINUX_KERNEL_CUSTOM_REPO_URL="https://github.com/msm8974-mainline/linux"
BR2_LINUX_KERNEL_CUSTOM_REPO_VERSION="qcom-msm8974-6.12.y"
BR2_LINUX_KERNEL_USE_CUSTOM_CONFIG=y
BR2_LINUX_KERNEL_CUSTOM_CONFIG_FILE="$(BR2_EXTERNAL_CITRONICS_PATH)/board/lemon_rauc/linux.config"
BR2_LINUX_KERNEL_DTS_SUPPORT=y
BR2_LINUX_KERNEL_INTREE_DTS_NAME="qcom/qcom-msm8974pro-fairphone-fp2"
BR2_LINUX_KERNEL_DTB_OVERLAY_SUPPORT=y

# Busybox
BR2_PACKAGE_BUSYBOX_CONFIG_FRAGMENT_FILES="$(BR2_EXTERNAL_CITRONICS_PATH)/board/lemon_rauc/busybox.config.fragment"
BR2_PACKAGE_BUSYBOX_SHOW_OTHERS=y

# Filesystem tools
BR2_PACKAGE_GENEXT2FS=y
BR2_PACKAGE_E2FSPROGS=y
BR2_PACKAGE_E2FSPROGS_RESIZE2FS=y

# Firmware
BR2_PACKAGE_LINUX_FIRMWARE=y
BR2_PACKAGE_LINUX_FIRMWARE_QCOM_ADRENO=y

# USB utilities
BR2_PACKAGE_KBD=y
BR2_PACKAGE_USBUTILS=y

# Bluetooth
BR2_PACKAGE_ELL=y
BR2_PACKAGE_BLUEZ_TOOLS=y
BR2_PACKAGE_BLUEZ5_UTILS=y
BR2_PACKAGE_BLUEZ5_UTILS_CLIENT=y
BR2_PACKAGE_BLUEZ5_UTILS_TOOLS=y
BR2_PACKAGE_BLUEZ5_UTILS_PLUGINS_HID=y

# Networking
BR2_PACKAGE_DHCP=y
BR2_PACKAGE_DHCP_SERVER=y
BR2_PACKAGE_IPTABLES=y
BR2_PACKAGE_MODEM_MANAGER_LIBQRTR=y
BR2_PACKAGE_NETWORK_MANAGER=y
BR2_PACKAGE_NETWORK_MANAGER_TUI=y
BR2_PACKAGE_NETWORK_MANAGER_CLI=y
BR2_PACKAGE_NETWORK_MANAGER_MODEM_MANAGER=y
BR2_PACKAGE_OPENSSH=y
BR2_PACKAGE_WIRELESS_REGDB=y
BR2_PACKAGE_WIRELESS_TOOLS=y
BR2_PACKAGE_WPA_SUPPLICANT=y
BR2_PACKAGE_WPA_SUPPLICANT_AP_SUPPORT=y
BR2_PACKAGE_WPA_SUPPLICANT_EAP=y
BR2_PACKAGE_WPA_SUPPLICANT_WPS=y
BR2_PACKAGE_WPA_SUPPLICANT_WPA3=y
BR2_PACKAGE_WPA_SUPPLICANT_CLI=y
BR2_PACKAGE_WPA_SUPPLICANT_WPA_CLIENT_SO=y
BR2_PACKAGE_WPA_SUPPLICANT_PASSPHRASE=y
BR2_PACKAGE_WPA_SUPPLICANT_DBUS=y

# Cryptography libraries
BR2_PACKAGE_OPENSSL=y
BR2_PACKAGE_OPENSSL_FORCE_LIBOPENSSL=y
BR2_PACKAGE_LIBOPENSSL_ENABLE_BLAKE2=y
BR2_PACKAGE_LIBOPENSSL_ENABLE_CHACHA=y
BR2_PACKAGE_LIBOPENSSL_ENABLE_POLY1305=y
BR2_PACKAGE_LIBOPENSSL_ENABLE_SM234=y

# RAUC - Update system
BR2_PACKAGE_RAUC=y
BR2_PACKAGE_RAUC_DBUS=y
BR2_PACKAGE_RAUC_GPT=y
BR2_PACKAGE_RAUC_NETWORK=y
BR2_PACKAGE_RAUC_JSON=y

# U-Boot tools for environment variable management
BR2_PACKAGE_UBOOT_TOOLS=y
BR2_PACKAGE_UBOOT_TOOLS_FWPRINTENV=y

# Host tools for RAUC
BR2_PACKAGE_HOST_RAUC=y
BR2_PACKAGE_HOST_GENEXT2FS=y
BR2_PACKAGE_HOST_GENIMAGE=y
BR2_PACKAGE_HOST_DOSFSTOOLS=y
BR2_PACKAGE_HOST_MTOOLS=y
BR2_PACKAGE_HOST_UBOOT_TOOLS=y

# Target filesystem
BR2_TARGET_ROOTFS_EXT2=y
BR2_TARGET_ROOTFS_EXT2_4=y
BR2_TARGET_ROOTFS_EXT2_SIZE="250M"

# Citronics packages
BR2_PACKAGE_FP2_FIRMWARE=y
BR2_PACKAGE_QRTR=y
BR2_PACKAGE_RMTFS=y
BR2_PACKAGE_SIM_SELECTOR=y
BR2_PACKAGE_CITRONICS_INITRAMFS=y
```

## buildroot-external/package/acdb-loader/Config.in
```kconfig
config BR2_PACKAGE_ACDB_LOADER
	bool "acdb-loader"
	help
	  Qualcomm ACDB (Audio Calibration Database) loader.
	  Loads audio calibration data from .acdb files and sends
	  it to the ADSP via the kernel audio calibration interface.
```

## buildroot-external/package/fp2-adsp-sensors-demo/Config.in
```kconfig
config BR2_PACKAGE_FP2_ADSP_SENSORS_DEMO
	bool "fp2-adsp-sensors-demo"
	help
	  Fairphone 2 demo script that reads all ADSP sensors
	  (accelerometer, gyroscope, magnetometer, proximity and
	  ambient light) through IIO and displays live values on
	  the console.
```

## buildroot-external/package/gps-assist/Config.in
```kconfig
config BR2_PACKAGE_GPS_ASSIST
	bool "GPS assistance data service"
	help
	  Downloads and injects XTRA predicted orbit data into the
	  Qualcomm modem to reduce GPS time-to-first-fix (TTFF).

	  Runs at boot and optionally refreshes XTRA data periodically
	  via a cron job (requires a cron daemon to be enabled).
```

## buildroot-external/package/kernel-tests/Config.in
```kconfig
config BR2_PACKAGE_KERNEL_TESTS
	bool "kernel-tests"
	help
	  Test scripts for verifying kernel features on the
	  Fairphone 2: CPU DVFS frequency scaling, thermal
	  management (including emulated trip-point throttling),
	  IOMMU operation, and SPM gang-rail voltage tracking.
	  Outputs results in TAP v13 format.
```

## buildroot-external/package/limeboard-ha/Config.in
```kconfig
config BR2_PACKAGE_LIMEBOARD_HA
	bool "limeboard-ha"
	depends on BR2_PACKAGE_PYTHON3
	depends on BR2_PACKAGE_HAS_UDEV # limeboard-io
	select BR2_PACKAGE_PYTHON_PAHO_MQTT
	select BR2_PACKAGE_LIMEBOARD_IO
	help
	  Makes the Limeboard a Home Assistant device through MQTT
	  discovery: the phone's system state and sensors, and the
	  board's RGB LED and button (GPIO lines of the Limeboard I/O
	  firmware). Configured in /etc/limeboard-ha.conf.

comment "limeboard-ha needs python3 and udev"
	depends on !BR2_PACKAGE_PYTHON3 || !BR2_PACKAGE_HAS_UDEV
```

## buildroot-external/package/limeboard-io/Config.in
```kconfig
config BR2_PACKAGE_LIMEBOARD_IO
	bool "limeboard-io"
	depends on BR2_PACKAGE_HAS_UDEV
	select BR2_PACKAGE_DFU_UTIL
	help
	  The Limeboard's STM32 with the Limeboard I/O firmware: its
	  Raspberry Pi style header as standard Linux devices through
	  the kernel's dln2 drivers (GPIO chip "dln2", I2C, SPI, ADC)
	  and a USB serial port for the header UART. Installs the udev
	  rule that binds dln2 to the firmware's USB ID, and dfu-util
	  to update the firmware.

	  Needs CONFIG_MFD_DLN2, GPIO_DLN2, I2C_DLN2, SPI_DLN2 and
	  DLN2_ADC in the kernel.

comment "limeboard-io needs udev"
	depends on !BR2_PACKAGE_HAS_UDEV
```

## buildroot-external/package/limeboard-mcu/Config.in
```kconfig
config BR2_PACKAGE_LIMEBOARD_MCU
	bool "limeboard-mcu"
	select BR2_PACKAGE_DFU_UTIL
	help
	  Tools for the Limeboard's STM32F401 (CircuitPython): run code
	  on it, open its REPL, install the bridge used by limeboard-ha,
	  and back up or reflash its flash through the ROM bootloader
	  (USB DFU) without touching a jumper.
```

## buildroot-external/package/modem-boot/Config.in
```kconfig
config BR2_PACKAGE_MODEM_BOOT
	bool "modem-boot"
	help
	  Init script to boot the modem remoteproc after the ADSP and
	  SLIMbus audio are fully initialized. Prevents the ADSP crash
	  that occurs when the modem boots too soon after the ADSP.
```

## buildroot-external/package/msm8974-diag/Config.in
```kconfig
config BR2_PACKAGE_MSM8974_DIAG
	bool "msm8974-diag"
	select BR2_PACKAGE_PYTHON3
	help
	  Diagnostics for the MSM8974 CPU power and clock path.

	  Read-only register probes (PMIC power-on/power-off reason,
	  HFPLL rates and lock state, SAW gang-rail voltage, per-core
	  LDO/BHS state, APC SMPS setpoints), DVFS stressors, and
	  resumable soak harnesses that keep fsync'd logs so a silent
	  reset still leaves evidence.

	  Written while investigating resets that produce no kernel
	  output at all on the 6.18 fork. See the package README for the
	  measurements, the safety rules (never offline a CPU, never
	  leave scaling_min_freq pinned high) and how to deploy onto a
	  freshly flashed device.
```

## buildroot-external/package/soak-logger/Config.in
```kconfig
config BR2_PACKAGE_SOAK_LOGGER
	bool "soak-logger"
	help
	  Unattended fsync'd telemetry sampler: one line every 30 s
	  (uptime, load, per-policy CPU frequency, thermal zone temps)
	  appended to /var/log/soak/. Starts at boot so a silent reset
	  always leaves evidence of the state just before it.
```
